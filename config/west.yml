## config/west.yml
```yaml
manifest:
  remotes:
    - name: chithanh12
      url-base: https://github.com/chithanh12
  projects:
    - name: zmk
      remote: chithanh12
      revision: thxph
      import: app/west.yml
  self:
    path: config
```
